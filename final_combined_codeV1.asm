;; DECLARE ALL THE PORTS, REGISTER, DATA VALUES
; PORTS
CS_PIN:		EQU 	80H 		
SCK_PIN:	EQU	81H	
MOSI_PIN:	EQU	82H	
MISO_PIN: 	EQU	00H
;REGISTERS AND DATA
USER_CTRL: 	EQU 	6AH
I2C_MST_EN: 	EQU	20H
I2C_MST_CTRL: 	EQU	24H 
I2C_MST_CLK: 	EQU	0DH
AK8963_CNTL1: 	EQU	0AH
AK8963_PWR_DOWN: EQU	00H
PWR_MGMNT_1: 	EQU	6BH
PWR_RESET: 	EQU	80H
AK8963_CNTL2: 	EQU	0BH
AK8963_RESET: 	EQU	01H
AK8963_FUSE_ROM: EQU	0FH
AK8963_ASA: 	EQU	10H
AK8963_CNT_MEAS1: EQU 	12H
AK8963_CNT_MEAS2: EQU 	16H 
AK8963_HXL: 	EQU	03H
I2C_SLV0_ADDR: 	EQU	25H
AK8963_I2C_ADDR: EQU	0CH
I2C_SLV0_REG: 	EQU 	26H
I2C_SLV0_D0: 	EQU	63H
I2C_SLV0_CTRL: 	EQU	27H
I2C_SLV0_EN: 	EQU	80H
I2C_READ_FLAG: 	EQU	80H
EXT_SENS_DATA_00: EQU 	49H
SPI_READ: 	EQU	80H
WHO_AM_I: 	EQU	75H
AK8963_WHO_AM_I: EQU 	00H
ACCEL_OUT: 	EQU	3BH
TRANS_LENGTH: 	EQU 	08H		
			
;; STACK POINTER AND HEAP POINTER HXL : 8100 HXH: 8101, HYL:8102, HYH: 8103

			LXI SP,0000H 	;; LOAD STACK POINTER
			LXI H,8100H	;; LOAD HEAP POINTER
MAIN:			CALL N0
			CALL DELAY
			CALL NE22
			CALL DELAY
			CALL NE45
			CALL DELAY
			CALL NE67
			CALL DELAY	
			CALL E90
			CALL DELAY
			CALL SE112
			CALL DELAY
			CALL SE135
			CALL DELAY
			CALL SE157
			CALL DELAY
			CALL S180
			CALL DELAY
			CALL SW202
			CALL DELAY
			CALL SW225
			CALL DELAY
			CALL SW247
			CALL DELAY	
			CALL W270
			CALL DELAY
			CALL NW292
			CALL DELAY
			CALL NW315
			CALL DELAY
			CALL NW337
			CALL DELAY
			RIM
			ANI 80H
			JZ START
			JMP MAIN
			
;; START IS CALLED WHEN SID SWITCH IS PRESSED, IT INITIALIZES THE MAGNEOTMETER AND JUMPS TO LOOP OUTPUT AFTER INITIALIZATION, SOD LED IS LIGHTED AFTER SUCCESSFUL INITIALIZATION
START: 			MVI B, USER_CTRL    ;; START INITIALIZATION SEQUENCE
			MVI C, I2C_MST_EN	
			CALL SPI_TRANSFER     ;; ENABLE I2C MASTER MODE
			MVI B, I2C_MST_CTRL
			MVI C, I2C_MST_CLK
			CALL SPI_TRANSFER	;; SET I2C BUS SPEED TO 400 kHz
			MVI D, AK8963_CNTL1
			MVI E, AK8963_PWR_DOWN
			CALL MAG_TRANSFER        ;; SET AK8963 TO POWER DOWN
			MVI B, PWR_MGMNT_1
			MVI C, PWR_RESET
			CALL SPI_TRANSFER 	;; RESET THE MPU
			CALL DELAY_1MS		;; WAIT FOR MPU-9250 TO POWER UP
			MVI D, AK8963_CNTL2	
			MVI E, AK8963_RESET 
			CALL MAG_TRANSFER	;;RESET AK8963
			CALL WHO_AM_I_CHECK		;; CHECK IF CORRECT VALUE
			MVI B, USER_CTRL
			MVI C,I2C_MST_EN
			CALL SPI_TRANSFER      ;; ENABLE I2C MASTER MODE
			MVI B, I2C_MST_CTRL
			MVI C, I2C_MST_CLK
			CALL SPI_TRANSFER      ;; SET I2C BUS SPEED TO 400 kHz
			CALL WHO_AM_I_AK8963
			MVI D, AK8963_CNTL1
			MVI E, AK8963_PWR_DOWN
			CALL MAG_TRANSFER       ;; AK8963 TO POWER DOWN
			CALL DELAY_100MS	;; LONG WAIT BEFORE MODE CHANGES
			MVI D, AK8963_CNTL1
			MVI E, AK8963_FUSE_ROM
			CALL MAG_TRANSFER  ;; SET AK8963 TO FUSE ROM ACCESS
			CALL DELAY_100MS
			MVI D, AK8963_CNTL1
			MVI E, AK8963_PWR_DOWN
			CALL MAG_TRANSFER
			CALL DELAY_100MS
			MVI D, AK8963_CNTL1
			MVI E, AK8963_CNT_MEAS2
			CALL MAG_TRANSFER 	;; SET AK8963 TO 16 BIT RESOLUTION 100 HZ REFRESH RATE
			CALL DELAY_100MS
			CALL SOD_LED   ;; SUCCESSFUL INIT
			JMP LOOP_OUTPUT 
;; MAG_TRANSFER IS THE FUNCTION USED TO TRANSFER VALUES FROM AK8963 REGISTERS
;; VALUES TO TRANSMIT ARE STORED IN D AND E. B AND C ARE USED FOR SPI_TRANSFER INSIDE MAG_TRANSFER
MAG_TRANSFER: 		MVI B, I2C_SLV0_ADDR
			MVI C, AK8963_I2C_ADDR
			CALL SPI_TRANSFER ;; SET SLAVE 0 TO AK8963 AND SET FOR WRITE
			MVI B, I2C_SLV0_REG
			MOV C, D
			CALL SPI_TRANSFER  ;; SET THE REGISTER TO DESIRED AK8963 SUBADDRESS
			MVI B, I2C_SLV0_D0
			MOV C, E
			CALL SPI_TRANSFER  ;;STORE DATA FOR WRITE
			MVI B, I2C_SLV0_CTRL
			MVI A, I2C_SLV0_EN
			ORI 01H
			MOV C, A
			CALL SPI_TRANSFER  ;; ENABLE I2C AND SEND 1 BYTE
			RET

;; CHECK THE VALUE IN WHO_AM_I REGISTER OF AK8963 
WHO_AM_I_CHECK:		MVI A, WHO_AM_I 
			ORI SPI_READ	;; SET VALIE FOR READ
			MOV B ,A
			MVI C, 00H ;; DUMMY BYTE ANYWAY
			CALL SPI_TRANSFER
			MOV A, C   ;; DATA RECIEVED IN C
			CPI 71H
			RZ
			CPI 73H
			RZ
			JMP FAILED
;; CHECK THE VALUE IN AK8963_WHO_AM_I SHOULD BE 48H
WHO_AM_I_AK8963:	MVI B, I2C_SLV0_ADDR
			MVI A, AK8963_I2C_ADDR
			ORI I2C_READ_FLAG	
			MOV C, A
			CALL SPI_TRANSFER ;; SET SLAVE 0 TO AK8963 AND SET FOR READ
			MVI B, I2C_SLV0_REG
			MVI C, AK8963_WHO_AM_I
			CALL SPI_TRANSFER   ;; SET THE REGISTER TO AK8963 WHO _AM_I
			MVI B, I2C_SLV0_CTRL
			MVI A, I2C_SLV0_EN
			ORI 01H
			MOV C, A
			CALL SPI_TRANSFER ;; ENABLE I2C AND REQUEST 1 BYTE
			CALL DELAY_1MS  ;; WAIT FOR EXTERNAL DATA REGISTERS TO FILL IN
			MVI A, EXT_SENS_DATA_00
			ORI SPI_READ
			MOV B, A
			MVI C, 00H ;; DUMMY BYTE ANYWAY
			CALL SPI_TRANSFER
			MOV A, C ;; COMPARE DATA RECIEVED
			CPI 48H
			RZ
			JMP FAILED
;; LOOP OUTPUT READS SENSOR VALUES AND OUTPUTS THE DIRECTION IN LED MATRIX
;; IT CALLS GET VALUES SUBROUTINE WHICH STORES DATA IN 4 SUBSEQUENT MEMORY LOCATIONS AND 
;; THEN FETCH_VALUES FUNCTION IS CALLED WHICH READS THE MEMORY LOCATIONS IN HEAP 
;; AND STORED THE VALUES IN B, C, D, E. THEN OUTPUT DECODER IS CALLED WHICH GLOWS THE LED DEPENDING UPON THE DIRECTION BASED ON ALGORITHM

LOOP_OUTPUT:	NOP
		;CALL GET_VALUES  	;; STORE MAG DATA IN HEAP
		;CALL FETCH_VALUES 	;; HXL: B HXH: C HYL: D, HYH: E
		;CALL OUTPUT_DECODER 	;; OUTPUT ONE OF THE VALUES
		;CALL DELAY_20MS	    	;; DELAY 20 MS
		JMP LOOP_OUTPUT	    	;; REPEAT

;; SPI TRANSFER SUBROUTINE TAKES INPUT IN B, C REGISTERS AND OUTPUT VALUE IS STORED IN B 
;; USES DE
SPI_TRANSFER: 	PUSH D
		CALL SCK_HIGH	; CLOCK STABLE AT HIGH VALUE
		CALL CS_LOW	; SELECT SLAVE
		MVI D, TRANS_LENGTH ; MOVE NUMBER OF BITS TO TRANSFER IN D
SEND_ADDRESS:	CALL SCK_LOW ; START TRANSFER
		MOV A, B ; MOVE REGISTER ADDRESS IN ACCUMULATOR TO TRANSFER
		ANI 80H ; AND 0X80 WITH B
		OUT MOSI_PIN; OUT 0 IF MSB IS 0 AND 1 IF MSB IS 1
ROTATE:		MOV A, B ; MOVE B IN ACCUMULATOR
		RLC; MSB TRANSMITTED - ROTATE NOW
		MOV B , A ; MOVE BACK
LATCH_INPUT:	CALL SCK_HIGH ; LATCH THE INPUT,DC STATIC 
OBTAIN_BIT:	IN 00H ; GET THE RECIEVED BYTE
		ORA A; REFLECT BIT VLAUE IN ACCUMULATOR
		JNZ SET_LSB ;MISO IS 1
RESET_LSB:	MOV A, B; MOVE INTO ACCUMULATOR
		ANI 0FEH; AND WITH 0 FEH TO RESET LSB
		MOV B, A; MOVE BYTE BACK IN B
		JMP NEXT
SET_LSB:	MOV A, B; MOVE INTO ACCUMULATOR
		ORI 01H; SET LSB
		MOV B, A; MOVE BYTE BACK IN B				
NEXT: 		DCR D
		JNZ SEND_ADDRESS

		MVI D, TRANS_LENGTH ; MOVE NUMBER OF BITS TO TRANSFER IN D
SEND_DATA:	CALL SCK_LOW ; START TRANSFER
		MOV A, C ; MOVE DATA IN ACCUMULATOR TO TRANSFER
		ANI 80H ; AND 0X80 WITH C
		OUT MOSI_PIN; OUT 0 IF MSB IS 0 AND 1 IF MSB IS 1
ROTATEd:	MOV A, C ; MOVE B IN ACCUMULATOR
		RLC; MSB TRANSMITTED - ROTATE NOW
		MOV C , A ; MOVE BACK
LATCH_INPUTd:	CALL SCK_HIGH ; LATCH THE INPUT,DC STATIC 
OBTAIN_BITd:	IN 00H ; GET THE RECIEVED BYTE
		ORA A; REFLECT BIT VLAUE IN ACCUMULATOR
		JNZ SET_LSBd ;MISO IS 1
RESET_LSBd:	MOV A, C; MOVE INTO ACCUMULATOR
		ANI 0FEH; AND WITH 0 FEH TO RESET LSB
		MOV C, A; MOVE BYTE BACK IN B
		JMP NEXTd
SET_LSBd:	MOV A, C; MOVE INTO ACCUMULATOR
		ORI 01H; SET LSB
		MOV C, A; MOVE BYTE BACK IN B
NEXTd: 		DCR D
		JNZ SEND_DATA
		CALL CS_HIGH
		POP D
		RET		
; UTILITY FUNCTIONS
CS_HIGH:	MVI A, 80H
		OUT 80H
		RET
CS_LOW:		MVI A, 00H
		OUT 80H
		RET
SCK_HIGH:	MVI A, 80H
		OUT 81H
		RET
SCK_LOW:	MVI A, 00H
		OUT 81H
		RET
SOD_LED: 	MVI A, 80H
		ORI 40H
		SIM
		RET				
N0: 	MVI A, 0FEH
	OUT 83H
	MVI A, 0FFH
	OUT 84H
	RET
NE22: 	MVI A, 0FDH
	OUT 83H
	MVI A, 0FFH
	OUT 84H
	RET
NE45: 	MVI A, 0FBH
	OUT 83H
	MVI A, 0FFH
	OUT 84H
	RET
NE67: 	MVI A, 0F7H
	OUT 83H
	MVI A, 0FFH
	OUT 84H
	RET
E90: 	MVI A, 0EFH
	OUT 83H
	MVI A, 0FFH
	OUT 84H
	RET
SE112: 	MVI A, 0DFH
	OUT 83H
	MVI A, 0FFH
	OUT 84H
	RET
SE135: 	MVI A, 0BFH
	OUT 83H
	MVI A, 0FFH
	OUT 84H
	RET
SE157: 	MVI A, 7FH
	OUT 83H
	MVI A, 0FFH
	OUT 84H
	RET
S180: 	MVI A, 0FEH
	OUT 84H
	MVI A, 0FFH
	OUT 83H
	RET
SW202: 	MVI A, 0FDH
	OUT 84H
	MVI A, 0FFH
	OUT 83H
	RET
SW225: 	MVI A, 0FBH
	OUT 84H
	MVI A, 0FFH
	OUT 83H
	RET
SW247: 	MVI A, 0F7H
	OUT 84H
	MVI A, 0FFH
	OUT 83H
	RET
W270: 	MVI A, 0EFH
	OUT 84H
	MVI A, 0FFH
	OUT 83H
	RET
NW292: 	MVI A, 0DFH
	OUT 84H
	MVI A, 0FFH
	OUT 83H
	RET
NW315: 	MVI A, 0BFH
	OUT 84H
	MVI A, 0FFH
	OUT 83H
	RET
NW337: 	MVI A, 7FH
	OUT 84H
	MVI A, 0FFH
	OUT 83H
	RET
DELAY:	PUSH B
	MVI B, 7BH
DELAYLoop1:	MVI C, 0E7H
DELAYLoop2:	DCR C
	   	JNZ DELAYLoop2
	   	DCR B
	   	JNZ DELAYLoop1
	   	POP B
		RET

DELAY_100MS:	PUSH B
	   	LXI B, 208CH
DELAY_100MSLoop:	NOP
			DCX B
	   		MOV A,B
	   		ORA C
	   		JNZ DELAY_100MSLoop
	   		POP B
			RET
DELAY_1MS:  	PUSH B
	   	LXI B,0052
DELAY_1MSLoop:	DCX B
	   	MOV A,B
	   	ORA C
	   	JNZ DELAY_1MSLoop
	   	POP B
		RET

DELAY_20MS:	PUSH B
		LXI B,0681
DELAY_20MSLoop:	DCX B
		MOV A,B
	   	ORA C
	   	JNZ DELAY_20MSLoop
	   	POP B
		RET
;; RESET LED_ARRAY: ALL PORTS ARE HALTED
RESET_LED_ARRAY: 	MVI A, 0FFH
			OUT 83H
			OUT 84H
			RET
;; FAILED : OUTPUT LED'S ARE STOPPED , ONLY SOD IS LIGHTED
FAILED: 	CALL RESET_LED_ARRAY
		CALL SOD_LED
		HLT		 